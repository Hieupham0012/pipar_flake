## config/Boards/shields/pipar_flake/Kconfig.defconfig
```kconfig
# Copyright (c) 2023 The ZMK Contributors
# SPDX-License-Identifier: MIT

if SHIELD_PIPAR_FLAKE

config ZMK_KEYBOARD_NAME
	default "Pipar Flake"

config ZMK_USB_LOGGING
	default y

endif
```

## config/Boards/shields/pipar_flake/Kconfig.shield
```kconfig
# Copyright (c) 2023 The ZMK Contributors
# SPDX-License-Identifier: MIT

config SHIELD_PIPAR_FLAKE
	def_bool $(shields_list_contains,pipar_flake)
```
